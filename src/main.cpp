#include <Arduino.h>
#include <SPI.h>
#include <Ethernet.h>
#include <SSLClient.h>
#include <certificates.h> // generated by python pycert_bearssl.py download howsmyssl.com

// Enter a MAC address and IP address for your controller below.
// The IP address will be dependent on your local network:
byte mac[] = {
    0xDE, 0xAD, 0xBE, 0xEF, 0xFE, 0xED};

#define ETH_SPI_BUS HSPI
#define ETH_MOSI 13
#define ETH_MISO 12
#define ETH_SCLK 14
#define ETH_CS 15

SPIClass ethernetSPI(ETH_SPI_BUS);

#define ANALOG_PIN_FOR_ENTRY 36

EthernetClient ethClient;
SSLClient client(ethClient, TAs, (size_t)TAs_NUM, ANALOG_PIN_FOR_ENTRY);

// Server URL
// matches trust anchors (TAs) from above
const char*  server = "www.howsmyssl.com";  

void setup()
{
    // You can use Ethernet.init(pin) to configure the CS pin and SPI
    // Init with specific pin settings from above.
    Ethernet.init(ETH_CS, &ethernetSPI, ETH_SCLK, ETH_MISO, ETH_MOSI);

    // Open serial communications and wait for port to open:
    Serial.begin(115200);
    while (!Serial)
    {
        ; // wait for serial port to connect. Needed for native USB port only
    }
    Serial.println("Ethernet WebServer Example");

    // start the Ethernet connection and the server:
    // use static IPs. Self-assign 192.168.0.37, set gateway & DNS as 192.168.0.1
    // this should match your home network settings
    IPAddress ip(192,168,0,37);
    IPAddress dns(192,168,0,1);
    IPAddress gateway(192,168,0,1);
    Serial.println("Trying to recognize hardware and join via static IP...");
    Ethernet.begin(mac/*, ip, dns, gateway*/);
    Serial.println("Got out of Ethernet.begin.");
    // Check for Ethernet hardware present
    if (Ethernet.hardwareStatus() == EthernetNoHardware)
    {
        Serial.println("Ethernet shield was not found.  Sorry, can't run without hardware. :(");
        while (true)
        {
            delay(1); // do nothing, no point running without Ethernet hardware
        }
    }
    if (Ethernet.linkStatus() == LinkOFF)
    {
        Serial.println("Ethernet cable is not connected.");
    }

    Serial.print("Joined LAN with IP ");
    Serial.println(Ethernet.localIP());
}

void loop()
{
  Serial.println("\nStarting connection to server " + String(server));
  if (!client.connect(server, 443))
    Serial.println("Connection failed!");
  else {
    Serial.println("Connected to server!");
    // Make a HTTP request:
    client.println("GET https://www.howsmyssl.com/a/check HTTP/1.0");
    client.println("Host: www.howsmyssl.com");
    // client.println("Connection: close");
    client.println();

    while (client.connected()) {
      String line = client.readStringUntil('\n');
      if (line == "\r") {
        Serial.println("headers received");
        break;
      }
    }
    // if there are incoming bytes available
    // from the server, read them and print them:
    while (client.available()) {
      char c = client.read();
      Serial.write(c);
    }
    Serial.println();

    client.stop();
  }

    delay(5000);
}
